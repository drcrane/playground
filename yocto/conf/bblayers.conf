## yocto/conf/bblayers.conf
```bitbake
# POKY_BBLAYERS_CONF_VERSION is increased each time build/conf/bblayers.conf
# changes incompatibly
POKY_BBLAYERS_CONF_VERSION = "2"

BBPATH = "${TOPDIR}"
BBFILES ?= ""

BBLAYERS ?= " \
  /home/yocto/project/poky/meta \
  /home/yocto/project/poky/meta-poky \
  /home/yocto/project/poky/meta-yocto-bsp \
  /home/yocto/project/meta-pfwd \
  /home/yocto/project/meta-autologin \
  /home/yocto/project/meta-openembedded/meta-oe \
  /home/yocto/project/meta-wayland \
  /home/yocto/project/meta-gui \
  "
```

## yocto/meta-autologin/conf/layer.conf
```bitbake
# We have a conf and classes directory, add to BBPATH
BBPATH .= ":${LAYERDIR}"

# We have recipes-* directories, add to BBFILES
BBFILES += "${LAYERDIR}/recipes-*/*/*.bb \
            ${LAYERDIR}/images/*.bb \
            ${LAYERDIR}/recipes-*/*/*.bbappend"

BBFILE_COLLECTIONS += "meta-autologin"
BBFILE_PATTERN_meta-autologin = "^${LAYERDIR}/"
BBFILE_PRIORITY_meta-autologin = "6"

LAYERDEPENDS_meta-autologin = "core"
LAYERSERIES_COMPAT_meta-autologin = "scarthgap styhead"
```
